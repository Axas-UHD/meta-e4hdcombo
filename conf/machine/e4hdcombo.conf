## conf/machine/e4hdcombo.conf
```bitbake
#@TYPE: Machine
#@NAME: Axas
#@DESCRIPTION: Machine configuration for the Axas E4hdcombo

IMAGEDIR ?= "e4hdcombo"

PREFERRED_VERSION_linux-e4hdcombo = "4.10.12"

MKUBIFS_ARGS = "-m 2048 -e 126976 -c 4096"
UBINIZE_ARGS = "-m 2048 -p 128KiB"

MACHINE_FEATURES += "dvb-c blindscan-dvbc blindscan-dvbs"

CHIPSET = "bcm73625"

require conf/machine/include/e4hdcombo.inc
```
